/* Automatically generated by generate-banked-rom.py. */

MEMORY {
  rom_bank1 (r) : ORIGIN = 0x818000, LENGTH = __rom_size >= 64 ? 0x8000 : 0
  rom_bank2 (r) : ORIGIN = 0x828000, LENGTH = __rom_size >= 96 ? 0x8000 : 0
  rom_bank3 (r) : ORIGIN = 0x838000, LENGTH = __rom_size >= 128 ? 0x8000 : 0
  rom_bank4 (r) : ORIGIN = 0x848000, LENGTH = __rom_size >= 160 ? 0x8000 : 0
  rom_bank5 (r) : ORIGIN = 0x858000, LENGTH = __rom_size >= 192 ? 0x8000 : 0
  rom_bank6 (r) : ORIGIN = 0x868000, LENGTH = __rom_size >= 224 ? 0x8000 : 0
  rom_bank7 (r) : ORIGIN = 0x878000, LENGTH = __rom_size >= 256 ? 0x8000 : 0
  rom_bank8 (r) : ORIGIN = 0x888000, LENGTH = __rom_size >= 288 ? 0x8000 : 0
  rom_bank9 (r) : ORIGIN = 0x898000, LENGTH = __rom_size >= 320 ? 0x8000 : 0
  rom_bank10 (r) : ORIGIN = 0x8a8000, LENGTH = __rom_size >= 352 ? 0x8000 : 0
  rom_bank11 (r) : ORIGIN = 0x8b8000, LENGTH = __rom_size >= 384 ? 0x8000 : 0
  rom_bank12 (r) : ORIGIN = 0x8c8000, LENGTH = __rom_size >= 416 ? 0x8000 : 0
  rom_bank13 (r) : ORIGIN = 0x8d8000, LENGTH = __rom_size >= 448 ? 0x8000 : 0
  rom_bank14 (r) : ORIGIN = 0x8e8000, LENGTH = __rom_size >= 480 ? 0x8000 : 0
  rom_bank15 (r) : ORIGIN = 0x8f8000, LENGTH = __rom_size >= 512 ? 0x8000 : 0
  rom_bank16 (r) : ORIGIN = 0x908000, LENGTH = __rom_size >= 544 ? 0x8000 : 0
  rom_bank17 (r) : ORIGIN = 0x918000, LENGTH = __rom_size >= 576 ? 0x8000 : 0
  rom_bank18 (r) : ORIGIN = 0x928000, LENGTH = __rom_size >= 608 ? 0x8000 : 0
  rom_bank19 (r) : ORIGIN = 0x938000, LENGTH = __rom_size >= 640 ? 0x8000 : 0
  rom_bank20 (r) : ORIGIN = 0x948000, LENGTH = __rom_size >= 672 ? 0x8000 : 0
  rom_bank21 (r) : ORIGIN = 0x958000, LENGTH = __rom_size >= 704 ? 0x8000 : 0
  rom_bank22 (r) : ORIGIN = 0x968000, LENGTH = __rom_size >= 736 ? 0x8000 : 0
  rom_bank23 (r) : ORIGIN = 0x978000, LENGTH = __rom_size >= 768 ? 0x8000 : 0
  rom_bank24 (r) : ORIGIN = 0x988000, LENGTH = __rom_size >= 800 ? 0x8000 : 0
  rom_bank25 (r) : ORIGIN = 0x998000, LENGTH = __rom_size >= 832 ? 0x8000 : 0
  rom_bank26 (r) : ORIGIN = 0x9a8000, LENGTH = __rom_size >= 864 ? 0x8000 : 0
  rom_bank27 (r) : ORIGIN = 0x9b8000, LENGTH = __rom_size >= 896 ? 0x8000 : 0
  rom_bank28 (r) : ORIGIN = 0x9c8000, LENGTH = __rom_size >= 928 ? 0x8000 : 0
  rom_bank29 (r) : ORIGIN = 0x9d8000, LENGTH = __rom_size >= 960 ? 0x8000 : 0
  rom_bank30 (r) : ORIGIN = 0x9e8000, LENGTH = __rom_size >= 992 ? 0x8000 : 0
  rom_bank31 (r) : ORIGIN = 0x9f8000, LENGTH = __rom_size >= 1024 ? 0x8000 : 0
  rom_bank32 (r) : ORIGIN = 0xa08000, LENGTH = __rom_size >= 1056 ? 0x8000 : 0
  rom_bank33 (r) : ORIGIN = 0xa18000, LENGTH = __rom_size >= 1088 ? 0x8000 : 0
  rom_bank34 (r) : ORIGIN = 0xa28000, LENGTH = __rom_size >= 1120 ? 0x8000 : 0
  rom_bank35 (r) : ORIGIN = 0xa38000, LENGTH = __rom_size >= 1152 ? 0x8000 : 0
  rom_bank36 (r) : ORIGIN = 0xa48000, LENGTH = __rom_size >= 1184 ? 0x8000 : 0
  rom_bank37 (r) : ORIGIN = 0xa58000, LENGTH = __rom_size >= 1216 ? 0x8000 : 0
  rom_bank38 (r) : ORIGIN = 0xa68000, LENGTH = __rom_size >= 1248 ? 0x8000 : 0
  rom_bank39 (r) : ORIGIN = 0xa78000, LENGTH = __rom_size >= 1280 ? 0x8000 : 0
  rom_bank40 (r) : ORIGIN = 0xa88000, LENGTH = __rom_size >= 1312 ? 0x8000 : 0
  rom_bank41 (r) : ORIGIN = 0xa98000, LENGTH = __rom_size >= 1344 ? 0x8000 : 0
  rom_bank42 (r) : ORIGIN = 0xaa8000, LENGTH = __rom_size >= 1376 ? 0x8000 : 0
  rom_bank43 (r) : ORIGIN = 0xab8000, LENGTH = __rom_size >= 1408 ? 0x8000 : 0
  rom_bank44 (r) : ORIGIN = 0xac8000, LENGTH = __rom_size >= 1440 ? 0x8000 : 0
  rom_bank45 (r) : ORIGIN = 0xad8000, LENGTH = __rom_size >= 1472 ? 0x8000 : 0
  rom_bank46 (r) : ORIGIN = 0xae8000, LENGTH = __rom_size >= 1504 ? 0x8000 : 0
  rom_bank47 (r) : ORIGIN = 0xaf8000, LENGTH = __rom_size >= 1536 ? 0x8000 : 0
  rom_bank48 (r) : ORIGIN = 0xb08000, LENGTH = __rom_size >= 1568 ? 0x8000 : 0
  rom_bank49 (r) : ORIGIN = 0xb18000, LENGTH = __rom_size >= 1600 ? 0x8000 : 0
  rom_bank50 (r) : ORIGIN = 0xb28000, LENGTH = __rom_size >= 1632 ? 0x8000 : 0
  rom_bank51 (r) : ORIGIN = 0xb38000, LENGTH = __rom_size >= 1664 ? 0x8000 : 0
  rom_bank52 (r) : ORIGIN = 0xb48000, LENGTH = __rom_size >= 1696 ? 0x8000 : 0
  rom_bank53 (r) : ORIGIN = 0xb58000, LENGTH = __rom_size >= 1728 ? 0x8000 : 0
  rom_bank54 (r) : ORIGIN = 0xb68000, LENGTH = __rom_size >= 1760 ? 0x8000 : 0
  rom_bank55 (r) : ORIGIN = 0xb78000, LENGTH = __rom_size >= 1792 ? 0x8000 : 0
  rom_bank56 (r) : ORIGIN = 0xb88000, LENGTH = __rom_size >= 1824 ? 0x8000 : 0
  rom_bank57 (r) : ORIGIN = 0xb98000, LENGTH = __rom_size >= 1856 ? 0x8000 : 0
  rom_bank58 (r) : ORIGIN = 0xba8000, LENGTH = __rom_size >= 1888 ? 0x8000 : 0
  rom_bank59 (r) : ORIGIN = 0xbb8000, LENGTH = __rom_size >= 1920 ? 0x8000 : 0
  rom_bank60 (r) : ORIGIN = 0xbc8000, LENGTH = __rom_size >= 1952 ? 0x8000 : 0
  rom_bank61 (r) : ORIGIN = 0xbd8000, LENGTH = __rom_size >= 1984 ? 0x8000 : 0
  rom_bank62 (r) : ORIGIN = 0xbe8000, LENGTH = __rom_size >= 2016 ? 0x8000 : 0
  rom_bank63 (r) : ORIGIN = 0xbf8000, LENGTH = __rom_size >= 2048 ? 0x8000 : 0
  rom_bank64 (r) : ORIGIN = 0xc08000, LENGTH = __rom_size >= 2080 ? 0x8000 : 0
  rom_bank65 (r) : ORIGIN = 0xc18000, LENGTH = __rom_size >= 2112 ? 0x8000 : 0
  rom_bank66 (r) : ORIGIN = 0xc28000, LENGTH = __rom_size >= 2144 ? 0x8000 : 0
  rom_bank67 (r) : ORIGIN = 0xc38000, LENGTH = __rom_size >= 2176 ? 0x8000 : 0
  rom_bank68 (r) : ORIGIN = 0xc48000, LENGTH = __rom_size >= 2208 ? 0x8000 : 0
  rom_bank69 (r) : ORIGIN = 0xc58000, LENGTH = __rom_size >= 2240 ? 0x8000 : 0
  rom_bank70 (r) : ORIGIN = 0xc68000, LENGTH = __rom_size >= 2272 ? 0x8000 : 0
  rom_bank71 (r) : ORIGIN = 0xc78000, LENGTH = __rom_size >= 2304 ? 0x8000 : 0
  rom_bank72 (r) : ORIGIN = 0xc88000, LENGTH = __rom_size >= 2336 ? 0x8000 : 0
  rom_bank73 (r) : ORIGIN = 0xc98000, LENGTH = __rom_size >= 2368 ? 0x8000 : 0
  rom_bank74 (r) : ORIGIN = 0xca8000, LENGTH = __rom_size >= 2400 ? 0x8000 : 0
  rom_bank75 (r) : ORIGIN = 0xcb8000, LENGTH = __rom_size >= 2432 ? 0x8000 : 0
  rom_bank76 (r) : ORIGIN = 0xcc8000, LENGTH = __rom_size >= 2464 ? 0x8000 : 0
  rom_bank77 (r) : ORIGIN = 0xcd8000, LENGTH = __rom_size >= 2496 ? 0x8000 : 0
  rom_bank78 (r) : ORIGIN = 0xce8000, LENGTH = __rom_size >= 2528 ? 0x8000 : 0
  rom_bank79 (r) : ORIGIN = 0xcf8000, LENGTH = __rom_size >= 2560 ? 0x8000 : 0
  rom_bank80 (r) : ORIGIN = 0xd08000, LENGTH = __rom_size >= 2592 ? 0x8000 : 0
  rom_bank81 (r) : ORIGIN = 0xd18000, LENGTH = __rom_size >= 2624 ? 0x8000 : 0
  rom_bank82 (r) : ORIGIN = 0xd28000, LENGTH = __rom_size >= 2656 ? 0x8000 : 0
  rom_bank83 (r) : ORIGIN = 0xd38000, LENGTH = __rom_size >= 2688 ? 0x8000 : 0
  rom_bank84 (r) : ORIGIN = 0xd48000, LENGTH = __rom_size >= 2720 ? 0x8000 : 0
  rom_bank85 (r) : ORIGIN = 0xd58000, LENGTH = __rom_size >= 2752 ? 0x8000 : 0
  rom_bank86 (r) : ORIGIN = 0xd68000, LENGTH = __rom_size >= 2784 ? 0x8000 : 0
  rom_bank87 (r) : ORIGIN = 0xd78000, LENGTH = __rom_size >= 2816 ? 0x8000 : 0
  rom_bank88 (r) : ORIGIN = 0xd88000, LENGTH = __rom_size >= 2848 ? 0x8000 : 0
  rom_bank89 (r) : ORIGIN = 0xd98000, LENGTH = __rom_size >= 2880 ? 0x8000 : 0
  rom_bank90 (r) : ORIGIN = 0xda8000, LENGTH = __rom_size >= 2912 ? 0x8000 : 0
  rom_bank91 (r) : ORIGIN = 0xdb8000, LENGTH = __rom_size >= 2944 ? 0x8000 : 0
  rom_bank92 (r) : ORIGIN = 0xdc8000, LENGTH = __rom_size >= 2976 ? 0x8000 : 0
  rom_bank93 (r) : ORIGIN = 0xdd8000, LENGTH = __rom_size >= 3008 ? 0x8000 : 0
  rom_bank94 (r) : ORIGIN = 0xde8000, LENGTH = __rom_size >= 3040 ? 0x8000 : 0
  rom_bank95 (r) : ORIGIN = 0xdf8000, LENGTH = __rom_size >= 3072 ? 0x8000 : 0
  rom_bank96 (r) : ORIGIN = 0xe08000, LENGTH = __rom_size >= 3104 ? 0x8000 : 0
  rom_bank97 (r) : ORIGIN = 0xe18000, LENGTH = __rom_size >= 3136 ? 0x8000 : 0
  rom_bank98 (r) : ORIGIN = 0xe28000, LENGTH = __rom_size >= 3168 ? 0x8000 : 0
  rom_bank99 (r) : ORIGIN = 0xe38000, LENGTH = __rom_size >= 3200 ? 0x8000 : 0
  rom_bank100 (r) : ORIGIN = 0xe48000, LENGTH = __rom_size >= 3232 ? 0x8000 : 0
  rom_bank101 (r) : ORIGIN = 0xe58000, LENGTH = __rom_size >= 3264 ? 0x8000 : 0
  rom_bank102 (r) : ORIGIN = 0xe68000, LENGTH = __rom_size >= 3296 ? 0x8000 : 0
  rom_bank103 (r) : ORIGIN = 0xe78000, LENGTH = __rom_size >= 3328 ? 0x8000 : 0
  rom_bank104 (r) : ORIGIN = 0xe88000, LENGTH = __rom_size >= 3360 ? 0x8000 : 0
  rom_bank105 (r) : ORIGIN = 0xe98000, LENGTH = __rom_size >= 3392 ? 0x8000 : 0
  rom_bank106 (r) : ORIGIN = 0xea8000, LENGTH = __rom_size >= 3424 ? 0x8000 : 0
  rom_bank107 (r) : ORIGIN = 0xeb8000, LENGTH = __rom_size >= 3456 ? 0x8000 : 0
  rom_bank108 (r) : ORIGIN = 0xec8000, LENGTH = __rom_size >= 3488 ? 0x8000 : 0
  rom_bank109 (r) : ORIGIN = 0xed8000, LENGTH = __rom_size >= 3520 ? 0x8000 : 0
  rom_bank110 (r) : ORIGIN = 0xee8000, LENGTH = __rom_size >= 3552 ? 0x8000 : 0
  rom_bank111 (r) : ORIGIN = 0xef8000, LENGTH = __rom_size >= 3584 ? 0x8000 : 0
  rom_bank112 (r) : ORIGIN = 0xf08000, LENGTH = __rom_size >= 3616 ? 0x8000 : 0
  rom_bank113 (r) : ORIGIN = 0xf18000, LENGTH = __rom_size >= 3648 ? 0x8000 : 0
  rom_bank114 (r) : ORIGIN = 0xf28000, LENGTH = __rom_size >= 3680 ? 0x8000 : 0
  rom_bank115 (r) : ORIGIN = 0xf38000, LENGTH = __rom_size >= 3712 ? 0x8000 : 0
  rom_bank116 (r) : ORIGIN = 0xf48000, LENGTH = __rom_size >= 3744 ? 0x8000 : 0
  rom_bank117 (r) : ORIGIN = 0xf58000, LENGTH = __rom_size >= 3776 ? 0x8000 : 0
  rom_bank118 (r) : ORIGIN = 0xf68000, LENGTH = __rom_size >= 3808 ? 0x8000 : 0
  rom_bank119 (r) : ORIGIN = 0xf78000, LENGTH = __rom_size >= 3840 ? 0x8000 : 0
  rom_bank120 (r) : ORIGIN = 0xf88000, LENGTH = __rom_size >= 3872 ? 0x8000 : 0
  rom_bank121 (r) : ORIGIN = 0xf98000, LENGTH = __rom_size >= 3904 ? 0x8000 : 0
  rom_bank122 (r) : ORIGIN = 0xfa8000, LENGTH = __rom_size >= 3936 ? 0x8000 : 0
  rom_bank123 (r) : ORIGIN = 0xfb8000, LENGTH = __rom_size >= 3968 ? 0x8000 : 0
  rom_bank124 (r) : ORIGIN = 0xfc8000, LENGTH = __rom_size >= 4000 ? 0x8000 : 0
  rom_bank125 (r) : ORIGIN = 0xfd8000, LENGTH = __rom_size >= 4032 ? 0x8000 : 0
  rom_bank126 (r) : ORIGIN = 0xfe8000, LENGTH = __rom_size >= 4064 ? 0x8000 : 0
  rom_bank127 (r) : ORIGIN = 0xff8000, LENGTH = __rom_size >= 4096 ? 0x8000 : 0
}

SECTIONS {
  .rom_bank1 : { KEEP(*(.rom_bank1 .rom_bank1.*)) } >rom_bank1
  .rom_bank2 : { KEEP(*(.rom_bank2 .rom_bank2.*)) } >rom_bank2
  .rom_bank3 : { KEEP(*(.rom_bank3 .rom_bank3.*)) } >rom_bank3
  .rom_bank4 : { KEEP(*(.rom_bank4 .rom_bank4.*)) } >rom_bank4
  .rom_bank5 : { KEEP(*(.rom_bank5 .rom_bank5.*)) } >rom_bank5
  .rom_bank6 : { KEEP(*(.rom_bank6 .rom_bank6.*)) } >rom_bank6
  .rom_bank7 : { KEEP(*(.rom_bank7 .rom_bank7.*)) } >rom_bank7
  .rom_bank8 : { KEEP(*(.rom_bank8 .rom_bank8.*)) } >rom_bank8
  .rom_bank9 : { KEEP(*(.rom_bank9 .rom_bank9.*)) } >rom_bank9
  .rom_bank10 : { KEEP(*(.rom_bank10 .rom_bank10.*)) } >rom_bank10
  .rom_bank11 : { KEEP(*(.rom_bank11 .rom_bank11.*)) } >rom_bank11
  .rom_bank12 : { KEEP(*(.rom_bank12 .rom_bank12.*)) } >rom_bank12
  .rom_bank13 : { KEEP(*(.rom_bank13 .rom_bank13.*)) } >rom_bank13
  .rom_bank14 : { KEEP(*(.rom_bank14 .rom_bank14.*)) } >rom_bank14
  .rom_bank15 : { KEEP(*(.rom_bank15 .rom_bank15.*)) } >rom_bank15
  .rom_bank16 : { KEEP(*(.rom_bank16 .rom_bank16.*)) } >rom_bank16
  .rom_bank17 : { KEEP(*(.rom_bank17 .rom_bank17.*)) } >rom_bank17
  .rom_bank18 : { KEEP(*(.rom_bank18 .rom_bank18.*)) } >rom_bank18
  .rom_bank19 : { KEEP(*(.rom_bank19 .rom_bank19.*)) } >rom_bank19
  .rom_bank20 : { KEEP(*(.rom_bank20 .rom_bank20.*)) } >rom_bank20
  .rom_bank21 : { KEEP(*(.rom_bank21 .rom_bank21.*)) } >rom_bank21
  .rom_bank22 : { KEEP(*(.rom_bank22 .rom_bank22.*)) } >rom_bank22
  .rom_bank23 : { KEEP(*(.rom_bank23 .rom_bank23.*)) } >rom_bank23
  .rom_bank24 : { KEEP(*(.rom_bank24 .rom_bank24.*)) } >rom_bank24
  .rom_bank25 : { KEEP(*(.rom_bank25 .rom_bank25.*)) } >rom_bank25
  .rom_bank26 : { KEEP(*(.rom_bank26 .rom_bank26.*)) } >rom_bank26
  .rom_bank27 : { KEEP(*(.rom_bank27 .rom_bank27.*)) } >rom_bank27
  .rom_bank28 : { KEEP(*(.rom_bank28 .rom_bank28.*)) } >rom_bank28
  .rom_bank29 : { KEEP(*(.rom_bank29 .rom_bank29.*)) } >rom_bank29
  .rom_bank30 : { KEEP(*(.rom_bank30 .rom_bank30.*)) } >rom_bank30
  .rom_bank31 : { KEEP(*(.rom_bank31 .rom_bank31.*)) } >rom_bank31
  .rom_bank32 : { KEEP(*(.rom_bank32 .rom_bank32.*)) } >rom_bank32
  .rom_bank33 : { KEEP(*(.rom_bank33 .rom_bank33.*)) } >rom_bank33
  .rom_bank34 : { KEEP(*(.rom_bank34 .rom_bank34.*)) } >rom_bank34
  .rom_bank35 : { KEEP(*(.rom_bank35 .rom_bank35.*)) } >rom_bank35
  .rom_bank36 : { KEEP(*(.rom_bank36 .rom_bank36.*)) } >rom_bank36
  .rom_bank37 : { KEEP(*(.rom_bank37 .rom_bank37.*)) } >rom_bank37
  .rom_bank38 : { KEEP(*(.rom_bank38 .rom_bank38.*)) } >rom_bank38
  .rom_bank39 : { KEEP(*(.rom_bank39 .rom_bank39.*)) } >rom_bank39
  .rom_bank40 : { KEEP(*(.rom_bank40 .rom_bank40.*)) } >rom_bank40
  .rom_bank41 : { KEEP(*(.rom_bank41 .rom_bank41.*)) } >rom_bank41
  .rom_bank42 : { KEEP(*(.rom_bank42 .rom_bank42.*)) } >rom_bank42
  .rom_bank43 : { KEEP(*(.rom_bank43 .rom_bank43.*)) } >rom_bank43
  .rom_bank44 : { KEEP(*(.rom_bank44 .rom_bank44.*)) } >rom_bank44
  .rom_bank45 : { KEEP(*(.rom_bank45 .rom_bank45.*)) } >rom_bank45
  .rom_bank46 : { KEEP(*(.rom_bank46 .rom_bank46.*)) } >rom_bank46
  .rom_bank47 : { KEEP(*(.rom_bank47 .rom_bank47.*)) } >rom_bank47
  .rom_bank48 : { KEEP(*(.rom_bank48 .rom_bank48.*)) } >rom_bank48
  .rom_bank49 : { KEEP(*(.rom_bank49 .rom_bank49.*)) } >rom_bank49
  .rom_bank50 : { KEEP(*(.rom_bank50 .rom_bank50.*)) } >rom_bank50
  .rom_bank51 : { KEEP(*(.rom_bank51 .rom_bank51.*)) } >rom_bank51
  .rom_bank52 : { KEEP(*(.rom_bank52 .rom_bank52.*)) } >rom_bank52
  .rom_bank53 : { KEEP(*(.rom_bank53 .rom_bank53.*)) } >rom_bank53
  .rom_bank54 : { KEEP(*(.rom_bank54 .rom_bank54.*)) } >rom_bank54
  .rom_bank55 : { KEEP(*(.rom_bank55 .rom_bank55.*)) } >rom_bank55
  .rom_bank56 : { KEEP(*(.rom_bank56 .rom_bank56.*)) } >rom_bank56
  .rom_bank57 : { KEEP(*(.rom_bank57 .rom_bank57.*)) } >rom_bank57
  .rom_bank58 : { KEEP(*(.rom_bank58 .rom_bank58.*)) } >rom_bank58
  .rom_bank59 : { KEEP(*(.rom_bank59 .rom_bank59.*)) } >rom_bank59
  .rom_bank60 : { KEEP(*(.rom_bank60 .rom_bank60.*)) } >rom_bank60
  .rom_bank61 : { KEEP(*(.rom_bank61 .rom_bank61.*)) } >rom_bank61
  .rom_bank62 : { KEEP(*(.rom_bank62 .rom_bank62.*)) } >rom_bank62
  .rom_bank63 : { KEEP(*(.rom_bank63 .rom_bank63.*)) } >rom_bank63
  .rom_bank64 : { KEEP(*(.rom_bank64 .rom_bank64.*)) } >rom_bank64
  .rom_bank65 : { KEEP(*(.rom_bank65 .rom_bank65.*)) } >rom_bank65
  .rom_bank66 : { KEEP(*(.rom_bank66 .rom_bank66.*)) } >rom_bank66
  .rom_bank67 : { KEEP(*(.rom_bank67 .rom_bank67.*)) } >rom_bank67
  .rom_bank68 : { KEEP(*(.rom_bank68 .rom_bank68.*)) } >rom_bank68
  .rom_bank69 : { KEEP(*(.rom_bank69 .rom_bank69.*)) } >rom_bank69
  .rom_bank70 : { KEEP(*(.rom_bank70 .rom_bank70.*)) } >rom_bank70
  .rom_bank71 : { KEEP(*(.rom_bank71 .rom_bank71.*)) } >rom_bank71
  .rom_bank72 : { KEEP(*(.rom_bank72 .rom_bank72.*)) } >rom_bank72
  .rom_bank73 : { KEEP(*(.rom_bank73 .rom_bank73.*)) } >rom_bank73
  .rom_bank74 : { KEEP(*(.rom_bank74 .rom_bank74.*)) } >rom_bank74
  .rom_bank75 : { KEEP(*(.rom_bank75 .rom_bank75.*)) } >rom_bank75
  .rom_bank76 : { KEEP(*(.rom_bank76 .rom_bank76.*)) } >rom_bank76
  .rom_bank77 : { KEEP(*(.rom_bank77 .rom_bank77.*)) } >rom_bank77
  .rom_bank78 : { KEEP(*(.rom_bank78 .rom_bank78.*)) } >rom_bank78
  .rom_bank79 : { KEEP(*(.rom_bank79 .rom_bank79.*)) } >rom_bank79
  .rom_bank80 : { KEEP(*(.rom_bank80 .rom_bank80.*)) } >rom_bank80
  .rom_bank81 : { KEEP(*(.rom_bank81 .rom_bank81.*)) } >rom_bank81
  .rom_bank82 : { KEEP(*(.rom_bank82 .rom_bank82.*)) } >rom_bank82
  .rom_bank83 : { KEEP(*(.rom_bank83 .rom_bank83.*)) } >rom_bank83
  .rom_bank84 : { KEEP(*(.rom_bank84 .rom_bank84.*)) } >rom_bank84
  .rom_bank85 : { KEEP(*(.rom_bank85 .rom_bank85.*)) } >rom_bank85
  .rom_bank86 : { KEEP(*(.rom_bank86 .rom_bank86.*)) } >rom_bank86
  .rom_bank87 : { KEEP(*(.rom_bank87 .rom_bank87.*)) } >rom_bank87
  .rom_bank88 : { KEEP(*(.rom_bank88 .rom_bank88.*)) } >rom_bank88
  .rom_bank89 : { KEEP(*(.rom_bank89 .rom_bank89.*)) } >rom_bank89
  .rom_bank90 : { KEEP(*(.rom_bank90 .rom_bank90.*)) } >rom_bank90
  .rom_bank91 : { KEEP(*(.rom_bank91 .rom_bank91.*)) } >rom_bank91
  .rom_bank92 : { KEEP(*(.rom_bank92 .rom_bank92.*)) } >rom_bank92
  .rom_bank93 : { KEEP(*(.rom_bank93 .rom_bank93.*)) } >rom_bank93
  .rom_bank94 : { KEEP(*(.rom_bank94 .rom_bank94.*)) } >rom_bank94
  .rom_bank95 : { KEEP(*(.rom_bank95 .rom_bank95.*)) } >rom_bank95
  .rom_bank96 : { KEEP(*(.rom_bank96 .rom_bank96.*)) } >rom_bank96
  .rom_bank97 : { KEEP(*(.rom_bank97 .rom_bank97.*)) } >rom_bank97
  .rom_bank98 : { KEEP(*(.rom_bank98 .rom_bank98.*)) } >rom_bank98
  .rom_bank99 : { KEEP(*(.rom_bank99 .rom_bank99.*)) } >rom_bank99
  .rom_bank100 : { KEEP(*(.rom_bank100 .rom_bank100.*)) } >rom_bank100
  .rom_bank101 : { KEEP(*(.rom_bank101 .rom_bank101.*)) } >rom_bank101
  .rom_bank102 : { KEEP(*(.rom_bank102 .rom_bank102.*)) } >rom_bank102
  .rom_bank103 : { KEEP(*(.rom_bank103 .rom_bank103.*)) } >rom_bank103
  .rom_bank104 : { KEEP(*(.rom_bank104 .rom_bank104.*)) } >rom_bank104
  .rom_bank105 : { KEEP(*(.rom_bank105 .rom_bank105.*)) } >rom_bank105
  .rom_bank106 : { KEEP(*(.rom_bank106 .rom_bank106.*)) } >rom_bank106
  .rom_bank107 : { KEEP(*(.rom_bank107 .rom_bank107.*)) } >rom_bank107
  .rom_bank108 : { KEEP(*(.rom_bank108 .rom_bank108.*)) } >rom_bank108
  .rom_bank109 : { KEEP(*(.rom_bank109 .rom_bank109.*)) } >rom_bank109
  .rom_bank110 : { KEEP(*(.rom_bank110 .rom_bank110.*)) } >rom_bank110
  .rom_bank111 : { KEEP(*(.rom_bank111 .rom_bank111.*)) } >rom_bank111
  .rom_bank112 : { KEEP(*(.rom_bank112 .rom_bank112.*)) } >rom_bank112
  .rom_bank113 : { KEEP(*(.rom_bank113 .rom_bank113.*)) } >rom_bank113
  .rom_bank114 : { KEEP(*(.rom_bank114 .rom_bank114.*)) } >rom_bank114
  .rom_bank115 : { KEEP(*(.rom_bank115 .rom_bank115.*)) } >rom_bank115
  .rom_bank116 : { KEEP(*(.rom_bank116 .rom_bank116.*)) } >rom_bank116
  .rom_bank117 : { KEEP(*(.rom_bank117 .rom_bank117.*)) } >rom_bank117
  .rom_bank118 : { KEEP(*(.rom_bank118 .rom_bank118.*)) } >rom_bank118
  .rom_bank119 : { KEEP(*(.rom_bank119 .rom_bank119.*)) } >rom_bank119
  .rom_bank120 : { KEEP(*(.rom_bank120 .rom_bank120.*)) } >rom_bank120
  .rom_bank121 : { KEEP(*(.rom_bank121 .rom_bank121.*)) } >rom_bank121
  .rom_bank122 : { KEEP(*(.rom_bank122 .rom_bank122.*)) } >rom_bank122
  .rom_bank123 : { KEEP(*(.rom_bank123 .rom_bank123.*)) } >rom_bank123
  .rom_bank124 : { KEEP(*(.rom_bank124 .rom_bank124.*)) } >rom_bank124
  .rom_bank125 : { KEEP(*(.rom_bank125 .rom_bank125.*)) } >rom_bank125
  .rom_bank126 : { KEEP(*(.rom_bank126 .rom_bank126.*)) } >rom_bank126
  .rom_bank127 : { KEEP(*(.rom_bank127 .rom_bank127.*)) } >rom_bank127
}
