/* Automatically generated by generate-banked-rom.py. */

MEMORY {
  rom_bank1 (r) : ORIGIN = 0xc10000, LENGTH = __rom_size >= 128 ? 0x10000 : 0
  rom_bank2 (r) : ORIGIN = 0xc20000, LENGTH = __rom_size >= 192 ? 0x10000 : 0
  rom_bank3 (r) : ORIGIN = 0xc30000, LENGTH = __rom_size >= 256 ? 0x10000 : 0
  rom_bank4 (r) : ORIGIN = 0xc40000, LENGTH = __rom_size >= 320 ? 0x10000 : 0
  rom_bank5 (r) : ORIGIN = 0xc50000, LENGTH = __rom_size >= 384 ? 0x10000 : 0
  rom_bank6 (r) : ORIGIN = 0xc60000, LENGTH = __rom_size >= 448 ? 0x10000 : 0
  rom_bank7 (r) : ORIGIN = 0xc70000, LENGTH = __rom_size >= 512 ? 0x10000 : 0
  rom_bank8 (r) : ORIGIN = 0xc80000, LENGTH = __rom_size >= 576 ? 0x10000 : 0
  rom_bank9 (r) : ORIGIN = 0xc90000, LENGTH = __rom_size >= 640 ? 0x10000 : 0
  rom_bank10 (r) : ORIGIN = 0xca0000, LENGTH = __rom_size >= 704 ? 0x10000 : 0
  rom_bank11 (r) : ORIGIN = 0xcb0000, LENGTH = __rom_size >= 768 ? 0x10000 : 0
  rom_bank12 (r) : ORIGIN = 0xcc0000, LENGTH = __rom_size >= 832 ? 0x10000 : 0
  rom_bank13 (r) : ORIGIN = 0xcd0000, LENGTH = __rom_size >= 896 ? 0x10000 : 0
  rom_bank14 (r) : ORIGIN = 0xce0000, LENGTH = __rom_size >= 960 ? 0x10000 : 0
  rom_bank15 (r) : ORIGIN = 0xcf0000, LENGTH = __rom_size >= 1024 ? 0x10000 : 0
  rom_bank16 (r) : ORIGIN = 0xd00000, LENGTH = __rom_size >= 1088 ? 0x10000 : 0
  rom_bank17 (r) : ORIGIN = 0xd10000, LENGTH = __rom_size >= 1152 ? 0x10000 : 0
  rom_bank18 (r) : ORIGIN = 0xd20000, LENGTH = __rom_size >= 1216 ? 0x10000 : 0
  rom_bank19 (r) : ORIGIN = 0xd30000, LENGTH = __rom_size >= 1280 ? 0x10000 : 0
  rom_bank20 (r) : ORIGIN = 0xd40000, LENGTH = __rom_size >= 1344 ? 0x10000 : 0
  rom_bank21 (r) : ORIGIN = 0xd50000, LENGTH = __rom_size >= 1408 ? 0x10000 : 0
  rom_bank22 (r) : ORIGIN = 0xd60000, LENGTH = __rom_size >= 1472 ? 0x10000 : 0
  rom_bank23 (r) : ORIGIN = 0xd70000, LENGTH = __rom_size >= 1536 ? 0x10000 : 0
  rom_bank24 (r) : ORIGIN = 0xd80000, LENGTH = __rom_size >= 1600 ? 0x10000 : 0
  rom_bank25 (r) : ORIGIN = 0xd90000, LENGTH = __rom_size >= 1664 ? 0x10000 : 0
  rom_bank26 (r) : ORIGIN = 0xda0000, LENGTH = __rom_size >= 1728 ? 0x10000 : 0
  rom_bank27 (r) : ORIGIN = 0xdb0000, LENGTH = __rom_size >= 1792 ? 0x10000 : 0
  rom_bank28 (r) : ORIGIN = 0xdc0000, LENGTH = __rom_size >= 1856 ? 0x10000 : 0
  rom_bank29 (r) : ORIGIN = 0xdd0000, LENGTH = __rom_size >= 1920 ? 0x10000 : 0
  rom_bank30 (r) : ORIGIN = 0xde0000, LENGTH = __rom_size >= 1984 ? 0x10000 : 0
  rom_bank31 (r) : ORIGIN = 0xdf0000, LENGTH = __rom_size >= 2048 ? 0x10000 : 0
  rom_bank32 (r) : ORIGIN = 0xe00000, LENGTH = __rom_size >= 2112 ? 0x10000 : 0
  rom_bank33 (r) : ORIGIN = 0xe10000, LENGTH = __rom_size >= 2176 ? 0x10000 : 0
  rom_bank34 (r) : ORIGIN = 0xe20000, LENGTH = __rom_size >= 2240 ? 0x10000 : 0
  rom_bank35 (r) : ORIGIN = 0xe30000, LENGTH = __rom_size >= 2304 ? 0x10000 : 0
  rom_bank36 (r) : ORIGIN = 0xe40000, LENGTH = __rom_size >= 2368 ? 0x10000 : 0
  rom_bank37 (r) : ORIGIN = 0xe50000, LENGTH = __rom_size >= 2432 ? 0x10000 : 0
  rom_bank38 (r) : ORIGIN = 0xe60000, LENGTH = __rom_size >= 2496 ? 0x10000 : 0
  rom_bank39 (r) : ORIGIN = 0xe70000, LENGTH = __rom_size >= 2560 ? 0x10000 : 0
  rom_bank40 (r) : ORIGIN = 0xe80000, LENGTH = __rom_size >= 2624 ? 0x10000 : 0
  rom_bank41 (r) : ORIGIN = 0xe90000, LENGTH = __rom_size >= 2688 ? 0x10000 : 0
  rom_bank42 (r) : ORIGIN = 0xea0000, LENGTH = __rom_size >= 2752 ? 0x10000 : 0
  rom_bank43 (r) : ORIGIN = 0xeb0000, LENGTH = __rom_size >= 2816 ? 0x10000 : 0
  rom_bank44 (r) : ORIGIN = 0xec0000, LENGTH = __rom_size >= 2880 ? 0x10000 : 0
  rom_bank45 (r) : ORIGIN = 0xed0000, LENGTH = __rom_size >= 2944 ? 0x10000 : 0
  rom_bank46 (r) : ORIGIN = 0xee0000, LENGTH = __rom_size >= 3008 ? 0x10000 : 0
  rom_bank47 (r) : ORIGIN = 0xef0000, LENGTH = __rom_size >= 3072 ? 0x10000 : 0
  rom_bank48 (r) : ORIGIN = 0xf00000, LENGTH = __rom_size >= 3136 ? 0x10000 : 0
  rom_bank49 (r) : ORIGIN = 0xf10000, LENGTH = __rom_size >= 3200 ? 0x10000 : 0
  rom_bank50 (r) : ORIGIN = 0xf20000, LENGTH = __rom_size >= 3264 ? 0x10000 : 0
  rom_bank51 (r) : ORIGIN = 0xf30000, LENGTH = __rom_size >= 3328 ? 0x10000 : 0
  rom_bank52 (r) : ORIGIN = 0xf40000, LENGTH = __rom_size >= 3392 ? 0x10000 : 0
  rom_bank53 (r) : ORIGIN = 0xf50000, LENGTH = __rom_size >= 3456 ? 0x10000 : 0
  rom_bank54 (r) : ORIGIN = 0xf60000, LENGTH = __rom_size >= 3520 ? 0x10000 : 0
  rom_bank55 (r) : ORIGIN = 0xf70000, LENGTH = __rom_size >= 3584 ? 0x10000 : 0
  rom_bank56 (r) : ORIGIN = 0xf80000, LENGTH = __rom_size >= 3648 ? 0x10000 : 0
  rom_bank57 (r) : ORIGIN = 0xf90000, LENGTH = __rom_size >= 3712 ? 0x10000 : 0
  rom_bank58 (r) : ORIGIN = 0xfa0000, LENGTH = __rom_size >= 3776 ? 0x10000 : 0
  rom_bank59 (r) : ORIGIN = 0xfb0000, LENGTH = __rom_size >= 3840 ? 0x10000 : 0
  rom_bank60 (r) : ORIGIN = 0xfc0000, LENGTH = __rom_size >= 3904 ? 0x10000 : 0
  rom_bank61 (r) : ORIGIN = 0xfd0000, LENGTH = __rom_size >= 3968 ? 0x10000 : 0
  rom_bank62 (r) : ORIGIN = 0xfe0000, LENGTH = __rom_size >= 4032 ? 0x10000 : 0
  rom_bank63 (r) : ORIGIN = 0xff0000, LENGTH = __rom_size >= 4096 ? 0x10000 : 0
}

SECTIONS {
  .rom_bank1 : { KEEP(*(.rom_bank1 .rom_bank1.*)) } >rom_bank1
  .rom_bank2 : { KEEP(*(.rom_bank2 .rom_bank2.*)) } >rom_bank2
  .rom_bank3 : { KEEP(*(.rom_bank3 .rom_bank3.*)) } >rom_bank3
  .rom_bank4 : { KEEP(*(.rom_bank4 .rom_bank4.*)) } >rom_bank4
  .rom_bank5 : { KEEP(*(.rom_bank5 .rom_bank5.*)) } >rom_bank5
  .rom_bank6 : { KEEP(*(.rom_bank6 .rom_bank6.*)) } >rom_bank6
  .rom_bank7 : { KEEP(*(.rom_bank7 .rom_bank7.*)) } >rom_bank7
  .rom_bank8 : { KEEP(*(.rom_bank8 .rom_bank8.*)) } >rom_bank8
  .rom_bank9 : { KEEP(*(.rom_bank9 .rom_bank9.*)) } >rom_bank9
  .rom_bank10 : { KEEP(*(.rom_bank10 .rom_bank10.*)) } >rom_bank10
  .rom_bank11 : { KEEP(*(.rom_bank11 .rom_bank11.*)) } >rom_bank11
  .rom_bank12 : { KEEP(*(.rom_bank12 .rom_bank12.*)) } >rom_bank12
  .rom_bank13 : { KEEP(*(.rom_bank13 .rom_bank13.*)) } >rom_bank13
  .rom_bank14 : { KEEP(*(.rom_bank14 .rom_bank14.*)) } >rom_bank14
  .rom_bank15 : { KEEP(*(.rom_bank15 .rom_bank15.*)) } >rom_bank15
  .rom_bank16 : { KEEP(*(.rom_bank16 .rom_bank16.*)) } >rom_bank16
  .rom_bank17 : { KEEP(*(.rom_bank17 .rom_bank17.*)) } >rom_bank17
  .rom_bank18 : { KEEP(*(.rom_bank18 .rom_bank18.*)) } >rom_bank18
  .rom_bank19 : { KEEP(*(.rom_bank19 .rom_bank19.*)) } >rom_bank19
  .rom_bank20 : { KEEP(*(.rom_bank20 .rom_bank20.*)) } >rom_bank20
  .rom_bank21 : { KEEP(*(.rom_bank21 .rom_bank21.*)) } >rom_bank21
  .rom_bank22 : { KEEP(*(.rom_bank22 .rom_bank22.*)) } >rom_bank22
  .rom_bank23 : { KEEP(*(.rom_bank23 .rom_bank23.*)) } >rom_bank23
  .rom_bank24 : { KEEP(*(.rom_bank24 .rom_bank24.*)) } >rom_bank24
  .rom_bank25 : { KEEP(*(.rom_bank25 .rom_bank25.*)) } >rom_bank25
  .rom_bank26 : { KEEP(*(.rom_bank26 .rom_bank26.*)) } >rom_bank26
  .rom_bank27 : { KEEP(*(.rom_bank27 .rom_bank27.*)) } >rom_bank27
  .rom_bank28 : { KEEP(*(.rom_bank28 .rom_bank28.*)) } >rom_bank28
  .rom_bank29 : { KEEP(*(.rom_bank29 .rom_bank29.*)) } >rom_bank29
  .rom_bank30 : { KEEP(*(.rom_bank30 .rom_bank30.*)) } >rom_bank30
  .rom_bank31 : { KEEP(*(.rom_bank31 .rom_bank31.*)) } >rom_bank31
  .rom_bank32 : { KEEP(*(.rom_bank32 .rom_bank32.*)) } >rom_bank32
  .rom_bank33 : { KEEP(*(.rom_bank33 .rom_bank33.*)) } >rom_bank33
  .rom_bank34 : { KEEP(*(.rom_bank34 .rom_bank34.*)) } >rom_bank34
  .rom_bank35 : { KEEP(*(.rom_bank35 .rom_bank35.*)) } >rom_bank35
  .rom_bank36 : { KEEP(*(.rom_bank36 .rom_bank36.*)) } >rom_bank36
  .rom_bank37 : { KEEP(*(.rom_bank37 .rom_bank37.*)) } >rom_bank37
  .rom_bank38 : { KEEP(*(.rom_bank38 .rom_bank38.*)) } >rom_bank38
  .rom_bank39 : { KEEP(*(.rom_bank39 .rom_bank39.*)) } >rom_bank39
  .rom_bank40 : { KEEP(*(.rom_bank40 .rom_bank40.*)) } >rom_bank40
  .rom_bank41 : { KEEP(*(.rom_bank41 .rom_bank41.*)) } >rom_bank41
  .rom_bank42 : { KEEP(*(.rom_bank42 .rom_bank42.*)) } >rom_bank42
  .rom_bank43 : { KEEP(*(.rom_bank43 .rom_bank43.*)) } >rom_bank43
  .rom_bank44 : { KEEP(*(.rom_bank44 .rom_bank44.*)) } >rom_bank44
  .rom_bank45 : { KEEP(*(.rom_bank45 .rom_bank45.*)) } >rom_bank45
  .rom_bank46 : { KEEP(*(.rom_bank46 .rom_bank46.*)) } >rom_bank46
  .rom_bank47 : { KEEP(*(.rom_bank47 .rom_bank47.*)) } >rom_bank47
  .rom_bank48 : { KEEP(*(.rom_bank48 .rom_bank48.*)) } >rom_bank48
  .rom_bank49 : { KEEP(*(.rom_bank49 .rom_bank49.*)) } >rom_bank49
  .rom_bank50 : { KEEP(*(.rom_bank50 .rom_bank50.*)) } >rom_bank50
  .rom_bank51 : { KEEP(*(.rom_bank51 .rom_bank51.*)) } >rom_bank51
  .rom_bank52 : { KEEP(*(.rom_bank52 .rom_bank52.*)) } >rom_bank52
  .rom_bank53 : { KEEP(*(.rom_bank53 .rom_bank53.*)) } >rom_bank53
  .rom_bank54 : { KEEP(*(.rom_bank54 .rom_bank54.*)) } >rom_bank54
  .rom_bank55 : { KEEP(*(.rom_bank55 .rom_bank55.*)) } >rom_bank55
  .rom_bank56 : { KEEP(*(.rom_bank56 .rom_bank56.*)) } >rom_bank56
  .rom_bank57 : { KEEP(*(.rom_bank57 .rom_bank57.*)) } >rom_bank57
  .rom_bank58 : { KEEP(*(.rom_bank58 .rom_bank58.*)) } >rom_bank58
  .rom_bank59 : { KEEP(*(.rom_bank59 .rom_bank59.*)) } >rom_bank59
  .rom_bank60 : { KEEP(*(.rom_bank60 .rom_bank60.*)) } >rom_bank60
  .rom_bank61 : { KEEP(*(.rom_bank61 .rom_bank61.*)) } >rom_bank61
  .rom_bank62 : { KEEP(*(.rom_bank62 .rom_bank62.*)) } >rom_bank62
  .rom_bank63 : { KEEP(*(.rom_bank63 .rom_bank63.*)) } >rom_bank63
}
